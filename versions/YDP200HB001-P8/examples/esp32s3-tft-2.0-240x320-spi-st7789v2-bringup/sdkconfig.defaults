## versions/YDP200HB001-P8/examples/esp32s3-tft-2.0-240x320-spi-st7789v2-bringup/sdkconfig.defaults
```kconfig
CONFIG_IDF_TARGET="esp32s3"

# LVGL
CONFIG_LV_COLOR_DEPTH_16=y
CONFIG_LV_USE_DEMO_WIDGETS=n
CONFIG_LV_USE_CHART=y
CONFIG_LV_FONT_MONTSERRAT_14=y
```
